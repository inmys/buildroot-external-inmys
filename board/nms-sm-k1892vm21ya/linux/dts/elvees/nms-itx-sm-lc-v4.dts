// SPDX-License-Identifier: GPL-2.0+
/*
 * NMS-ITX-SM-LC-V4 - mini-ITX SMARC carrier
 *
 * The carrier provides: 2 x GbE, HDMI, DP (via DP-to-VGA), DSI/LVDS,
 * M.2 SATA, CAN (buffered to UART), I2S audio, fan control, I2C GPIO
 * expander and an EEPROM with the carrier ID.
 *
 * Only the bring-up relevant part is described here; the rest is added
 * as it gets validated on hardware.
 *
 * Copyright (C) 2026 INMYS
 */

/dts-v1/;

#include "nms-sm-k1892vm21ya.dtsi"

/ {
	model = "INMYS NMS-SM-K1892VM21YA V1 on NMS-ITX-SM-LC-V4";
	compatible = "inmys,nms-itx-sm-lc-v4",
		     "inmys,nms-sm-k1892vm21ya",
		     "inmys,nms-sm-k1892",
		     "elvees,mcom03r";

	chosen {
		stdout-path = "serial0:115200n8";
	};

	aliases {
		ethernet0 = &emac0;
		ethernet1 = &emac1;
	};
};

/* UART, SDIO, Ethernet, USB and PCIe0 use the module defaults. */
&adv7513 {
	status = "okay";
};
