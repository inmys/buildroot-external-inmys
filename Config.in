## package/inmys-vision/Config.in
```kconfig
config BR2_PACKAGE_INMYS_VISION
	bool "inmys CSI video: HDMI, H.264 RTSP and HTTP MJPEG"
	depends on BR2_LINUX_KERNEL && BR2_TOOLCHAIN_USES_GLIBC
	depends on BR2_INSTALL_LIBSTDCPP && !BR2_STATIC_LIBS
	depends on BR2_TOOLCHAIN_HAS_THREADS && BR2_USE_WCHAR && BR2_USE_MMU
	select BR2_PACKAGE_LIBGPIOD
	select BR2_PACKAGE_ELVEES_GST_FELIX
	select BR2_PACKAGE_ELVEES_VPU_MODULES
	select BR2_PACKAGE_ELVEES_ELCORENN
	select BR2_PACKAGE_ELVEES_YOLOV8N
	select BR2_PACKAGE_GST1_PLUGINS_BASE
	select BR2_PACKAGE_GST1_PLUGINS_BASE_PLUGIN_APP
	select BR2_PACKAGE_GST1_PLUGINS_BASE_PLUGIN_VIDEOCONVERTSCALE
	select BR2_PACKAGE_GST1_PLUGINS_BASE_PLUGIN_VIDEORATE
	select BR2_PACKAGE_GST1_PLUGINS_BASE_PLUGIN_VIDEOTESTSRC
	select BR2_PACKAGE_GST1_PLUGINS_GOOD
	select BR2_PACKAGE_GST1_PLUGINS_GOOD_PLUGIN_V4L2
	select BR2_PACKAGE_GST1_PLUGINS_GOOD_PLUGIN_V4L2_PROBE
	select BR2_PACKAGE_GST1_PLUGINS_GOOD_JPEG
	select BR2_PACKAGE_GST1_PLUGINS_GOOD_PLUGIN_IMAGEFREEZE
	select BR2_PACKAGE_GST1_PLUGINS_BAD
	select BR2_PACKAGE_GST1_PLUGINS_BAD_PLUGIN_KMS
	select BR2_PACKAGE_GST1_PLUGINS_BAD_PLUGIN_VIDEOPARSERS
	select BR2_PACKAGE_GST1_PLUGINS_UGLY
	select BR2_PACKAGE_GST1_PLUGINS_UGLY_PLUGIN_X264
	select BR2_PACKAGE_GST1_RTSP_SERVER
	help
	  Felix ISP capture, optional HDMI, shared H.264 RTSP and browser
	  MJPEG preview with YOLOv8n inference on ELcore50 DSP.
	  H.264 and MJPEG encoding runs on Mali-V61 VPU. Software encoders
	  remain available through an explicit command-line option.
	  There is no CPU inference fallback.
```

## package/kconfiglib/Config.in
```kconfig
config BR2_PACKAGE_HOST_KCONFIGLIB
	bool
	help
	  kconfiglib Kconfig frontends (genconfig, olddefconfig, ...)
	  used by the ELVEES ddrinit and SBL build systems.
```

## package/mcom03-sbl/Config.in
```kconfig
config BR2_PACKAGE_MCOM03_SBL
	bool "mcom03-sbl"
	depends on BR2_aarch64
	depends on BR2_PACKAGE_DDRINIT
	depends on BR2_TARGET_ARM_TRUSTED_FIRMWARE
	depends on BR2_TARGET_UBOOT
	help
	  Second bootloader (SBL-XIP) for the ELVEES MCom-03
	  (К1892ВМ21Я).  It is stored in the QSPI0 boot flash and copies
	  ddrinit, TF-A, U-Boot and the U-Boot device tree to DDR.

comment "mcom03-sbl needs ddrinit, TF-A and U-Boot"
	depends on !BR2_PACKAGE_DDRINIT || !BR2_TARGET_ARM_TRUSTED_FIRMWARE || \
		!BR2_TARGET_UBOOT
```

## package/tusb926x-flash-burner/Config.in
```kconfig
config BR2_PACKAGE_TUSB926X_FLASH_BURNER
	bool "tusb926x-flash-burner"
	depends on BR2_INSTALL_LIBSTDCPP
	select BR2_PACKAGE_LIBUSB
	help
	  In-circuit flash programmer for the TI TUSB9260/TUSB9261
	  USB 3.0 to SATA bridge.

	  The bridge has no application flash of its own: its boot code
	  loads an image from the attached SPI flash into RAM, and with
	  no valid image it idles in a HID boot loader.  This tool talks
	  to that boot loader and writes the image, so the bridge can be
	  programmed without desoldering the SPI flash.

	  On the NMS-SM-K1892VM21YA the SPI flash (D15) is wired to
	  nothing but the bridge, and the bridge sits on downstream port
	  1 of the TUSB8041 hub, which is not brought out to the SMARC
	  connector.  The SoC is therefore the only host that can reach
	  it, and this tool has to run on the module itself.

	  Local patch 0001 talks to /dev/hidraw directly instead of
	  going through hidapi, so no udev is required.

	  https://github.com/luxonis/tusb926x-flash-burner
```
