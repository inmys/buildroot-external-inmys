## Config.in
```kconfig
comment "NMS-SM-K1892VM21YA support needs an AArch64 target"
	depends on !BR2_aarch64

if BR2_aarch64

source "$BR2_EXTERNAL_INMYS_NMS_SM_K1892_PATH/package/ddrinit/Config.in"
source "$BR2_EXTERNAL_INMYS_NMS_SM_K1892_PATH/package/elvees-mcom03-tools/Config.in"
source "$BR2_EXTERNAL_INMYS_NMS_SM_K1892_PATH/package/kconfiglib/Config.in"
source "$BR2_EXTERNAL_INMYS_NMS_SM_K1892_PATH/package/mcom03-sbl/Config.in"
source "$BR2_EXTERNAL_INMYS_NMS_SM_K1892_PATH/package/tusb926x-flash-burner/Config.in"

source "$BR2_EXTERNAL_INMYS_NMS_SM_K1892_PATH/package/elvees-sensor-phy/Config.in"

source "$BR2_EXTERNAL_INMYS_NMS_SM_K1892_PATH/package/elvees-dmabuf-exporter/Config.in"

source "$BR2_EXTERNAL_INMYS_NMS_SM_K1892_PATH/package/elvees-felix/Config.in"

source "$BR2_EXTERNAL_INMYS_NMS_SM_K1892_PATH/package/elvees-gst-felix/Config.in"

source "$BR2_EXTERNAL_INMYS_NMS_SM_K1892_PATH/package/elvees-rogue-modules/Config.in"
source "$BR2_EXTERNAL_INMYS_NMS_SM_K1892_PATH/package/elvees-powervr-opencl/Config.in"
source "$BR2_EXTERNAL_INMYS_NMS_SM_K1892_PATH/package/elvees-powervr-graphics/Config.in"
source "$BR2_EXTERNAL_INMYS_NMS_SM_K1892_PATH/package/elvees-elcore50/Config.in"
source "$BR2_EXTERNAL_INMYS_NMS_SM_K1892_PATH/package/elvees-elcorenn/Config.in"
source "$BR2_EXTERNAL_INMYS_NMS_SM_K1892_PATH/package/elvees-yolov8n/Config.in"
source "$BR2_EXTERNAL_INMYS_NMS_SM_K1892_PATH/package/elvees-vpu-modules/Config.in"
source "$BR2_EXTERNAL_INMYS_NMS_SM_K1892_PATH/package/inmys-vision/Config.in"

source "$BR2_EXTERNAL_INMYS_NMS_SM_K1892_PATH/package/inmys-browser/Config.in"

endif
```

## configs/nms_sm_k1892vm21ya_defconfig
```kconfig
BR2_aarch64=y
BR2_KERNEL_HEADERS_6_18=y
BR2_TOOLCHAIN_BUILDROOT_CXX=y
BR2_GLOBAL_PATCH_DIR="$(BR2_EXTERNAL_INMYS_NMS_SM_K1892_PATH)/patches/packages"
BR2_WGET="wget -nd -t 2 --connect-timeout=10 --timeout=45"
BR2_TARGET_GENERIC_HOSTNAME="nms-sm-k1892"
BR2_TARGET_GENERIC_ISSUE="NMS-SM-K1892VM21YA (ELVEES MCom-03R)"
BR2_TARGET_GENERIC_ROOT_PASSWD="root"
BR2_TARGET_GENERIC_GETTY_PORT="ttyS0"
BR2_TARGET_GENERIC_GETTY_BAUDRATE_115200=y
BR2_SYSTEM_DHCP="eth0"
BR2_ROOTFS_OVERLAY="$(BR2_EXTERNAL_INMYS_NMS_SM_K1892_PATH)/board/nms-sm-k1892vm21ya/rootfs-overlay"
BR2_ROOTFS_POST_BUILD_SCRIPT="$(BR2_EXTERNAL_INMYS_NMS_SM_K1892_PATH)/board/nms-sm-k1892vm21ya/post-build.sh"
BR2_ROOTFS_POST_IMAGE_SCRIPT="$(BR2_EXTERNAL_INMYS_NMS_SM_K1892_PATH)/board/nms-sm-k1892vm21ya/post-image.sh"
BR2_LINUX_KERNEL=y
BR2_LINUX_KERNEL_CUSTOM_GIT=y
BR2_LINUX_KERNEL_CUSTOM_REPO_URL="https://github.com/elvees/linux"
BR2_LINUX_KERNEL_CUSTOM_REPO_VERSION="mcom03-6.18.y"
BR2_LINUX_KERNEL_PATCH="$(BR2_EXTERNAL_INMYS_NMS_SM_K1892_PATH)/patches/linux"
BR2_LINUX_KERNEL_DEFCONFIG="mcom03r"
BR2_LINUX_KERNEL_CONFIG_FRAGMENT_FILES="$(BR2_EXTERNAL_INMYS_NMS_SM_K1892_PATH)/board/nms-sm-k1892vm21ya/linux/nms-sm-k1892vm21ya_linux.fragment"
BR2_LINUX_KERNEL_DTS_SUPPORT=y
BR2_LINUX_KERNEL_CUSTOM_DTS_DIR="$(BR2_EXTERNAL_INMYS_NMS_SM_K1892_PATH)/board/nms-sm-k1892vm21ya/linux/dts"
BR2_LINUX_KERNEL_DTB_KEEP_DIRNAME=y
BR2_LINUX_KERNEL_INSTALL_TARGET=y
BR2_LINUX_KERNEL_NEEDS_HOST_OPENSSL=y
BR2_PACKAGE_BUSYBOX_SHOW_OTHERS=y
BR2_PACKAGE_ALSA_UTILS=y
BR2_PACKAGE_ALSA_UTILS_AMIXER=y
BR2_PACKAGE_ALSA_UTILS_APLAY=y
BR2_PACKAGE_ALSA_UTILS_SPEAKER_TEST=y
BR2_PACKAGE_STRESS_NG=y
BR2_PACKAGE_DOSFSTOOLS=y
BR2_PACKAGE_DOSFSTOOLS_MKFS_FAT=y
BR2_PACKAGE_E2FSPROGS=y
BR2_PACKAGE_E2FSPROGS_RESIZE2FS=y
BR2_PACKAGE_PARTED=y
BR2_PACKAGE_MTD=y
BR2_PACKAGE_MTD_MKFSJFFS2=y
BR2_PACKAGE_LINUX_FIRMWARE=y
BR2_PACKAGE_LINUX_FIRMWARE_IWLWIFI_7260=y
BR2_PACKAGE_LINUX_FIRMWARE_IWLWIFI_7265D=y
BR2_PACKAGE_LINUX_FIRMWARE_IWLWIFI_6E=y
BR2_PACKAGE_LINUX_FIRMWARE_RTL_815X=y
BR2_PACKAGE_I2C_TOOLS=y
BR2_PACKAGE_MDIO_TOOLS=y
BR2_PACKAGE_MEMTESTER=y
BR2_PACKAGE_PCIUTILS=y
BR2_PACKAGE_STM32FLASH=y
BR2_PACKAGE_ACPID=y
BR2_PACKAGE_UBOOT_TOOLS=y
BR2_PACKAGE_OPENSSL=y
BR2_PACKAGE_LIBCONFIG=y
BR2_PACKAGE_LIBDRM_INSTALL_TESTS=y
BR2_PACKAGE_LIBGPIOD_TOOLS=y
BR2_PACKAGE_LIBV4L=y
BR2_PACKAGE_LIBV4L_UTILS=y
BR2_PACKAGE_CAN_UTILS=y
BR2_PACKAGE_DROPBEAR=y
BR2_PACKAGE_ETHTOOL=y
BR2_PACKAGE_IPERF3=y
BR2_PACKAGE_IPROUTE2=y
BR2_PACKAGE_IW=y
BR2_PACKAGE_LRZSZ=y
BR2_PACKAGE_WIRELESS_REGDB=y
BR2_PACKAGE_WPA_SUPPLICANT=y
BR2_PACKAGE_WPA_SUPPLICANT_CLI=y
BR2_PACKAGE_WPA_SUPPLICANT_PASSPHRASE=y
BR2_PACKAGE_HTOP=y
BR2_PACKAGE_SWUPDATE=y
BR2_PACKAGE_SWUPDATE_CONFIG="$(BR2_EXTERNAL_INMYS_NMS_SM_K1892_PATH)/board/nms-sm-k1892vm21ya/swupdate.config"
BR2_TARGET_ROOTFS_EXT2=y
BR2_TARGET_ROOTFS_EXT2_4=y
BR2_TARGET_ROOTFS_EXT2_SIZE="512M"
BR2_TARGET_ROOTFS_TAR_GZIP=y
BR2_TARGET_ARM_TRUSTED_FIRMWARE=y
BR2_TARGET_ARM_TRUSTED_FIRMWARE_CUSTOM_GIT=y
BR2_TARGET_ARM_TRUSTED_FIRMWARE_CUSTOM_REPO_URL="https://github.com/elvees/arm-trusted-firmware"
BR2_TARGET_ARM_TRUSTED_FIRMWARE_CUSTOM_REPO_VERSION="mcom03"
BR2_TARGET_ARM_TRUSTED_FIRMWARE_PLATFORM="mcom03"
BR2_TARGET_ARM_TRUSTED_FIRMWARE_SSP=y
BR2_TARGET_UBOOT=y
BR2_TARGET_UBOOT_BUILD_SYSTEM_KCONFIG=y
BR2_TARGET_UBOOT_CUSTOM_GIT=y
BR2_TARGET_UBOOT_CUSTOM_REPO_URL="https://github.com/elvees/u-boot"
BR2_TARGET_UBOOT_CUSTOM_REPO_VERSION="mcom03"
BR2_TARGET_UBOOT_PATCH="$(BR2_EXTERNAL_INMYS_NMS_SM_K1892_PATH)/patches/uboot"
BR2_TARGET_UBOOT_BOARD_DEFCONFIG="mcom03r"
BR2_TARGET_UBOOT_CONFIG_FRAGMENT_FILES="$(BR2_EXTERNAL_INMYS_NMS_SM_K1892_PATH)/board/nms-sm-k1892vm21ya/uboot/nms-sm-k1892vm21ya_uboot.fragment"
BR2_TARGET_UBOOT_CUSTOM_DTS_PATH="$(BR2_EXTERNAL_INMYS_NMS_SM_K1892_PATH)/board/nms-sm-k1892vm21ya/uboot/mcom03r-nms-sm-k1892vm21ya.dts"
BR2_TARGET_UBOOT_NEEDS_DTC=y
BR2_TARGET_UBOOT_NEEDS_PYLIBFDT=y
BR2_TARGET_UBOOT_NEEDS_PYELFTOOLS=y
BR2_TARGET_UBOOT_NEEDS_OPENSSL=y
BR2_PACKAGE_HOST_GENIMAGE=y
BR2_PACKAGE_HOST_UBOOT_TOOLS=y
BR2_PACKAGE_DDRINIT=y
BR2_PACKAGE_MCOM03_SBL=y
BR2_PACKAGE_TUSB926X_FLASH_BURNER=y
BR2_PACKAGE_INMYS_VISION=y
BR2_PACKAGE_CLINFO=y
BR2_PACKAGE_SPIDEV_TEST=y
BR2_ROOTFS_DEVICE_CREATION_DYNAMIC_EUDEV=y
BR2_PACKAGE_ELVEES_POWERVR_OPENCL=y
BR2_PACKAGE_INMYS_BROWSER=y
BR2_PACKAGE_OPENNTPD=y
# BR2_PACKAGE_WESTON_SHELL_DESKTOP is not set
# BR2_PACKAGE_WESTON_SHELL_FULLSCREEN is not set
# BR2_PACKAGE_WESTON_SHELL_IVI is not set
# BR2_PACKAGE_WESTON_SCREENSHARE is not set
```

## package/ddrinit/Config.in
```kconfig
config BR2_PACKAGE_DDRINIT
	bool "ddrinit"
	depends on BR2_aarch64
	select BR2_PACKAGE_HOST_KCONFIGLIB
	select BR2_PACKAGE_HOST_ELVEES_MCOM03_TOOLS
	help
	  DDR initializer for the ELVEES MCom-03 (К1892ВМ21Я) DDR
	  subsystem.  Bare-metal MIPS32 firmware which runs on the RISC0
	  core before TF-A and trains the LPDDR4/DDR4 interface.

	  The images are installed to BINARIES_DIR/ddrinit-<defconfig>/.
```

## package/elvees-dmabuf-exporter/Config.in
```kconfig
config BR2_PACKAGE_ELVEES_DMABUF_EXPORTER
	bool "elvees-dmabuf-exporter"
	depends on BR2_LINUX_KERNEL
	help
	  ELVEES external kernel module, built against the selected kernel.
	  Sources imported from the official ALT Linux source RPM; see ORIGIN.
```

## package/elvees-elcore50/Config.in
```kconfig
config BR2_PACKAGE_ELVEES_ELCORE50
	bool "ELVEES ELcore50 DSP kernel driver"
	depends on BR2_LINUX_KERNEL
	help
	  Build elcore50 and elcore50-mmualloc for MCom-03 from source.
```

## package/elvees-elcorenn/Config.in
```kconfig
config BR2_PACKAGE_ELVEES_ELCORENN
	bool "ElcoreNN 1.8.0 DSP runtime (vendor SDK binaries)"
	depends on BR2_LINUX_KERNEL && BR2_TOOLCHAIN_USES_GLIBC
	depends on BR2_INSTALL_LIBSTDCPP && !BR2_STATIC_LIBS
	select BR2_PACKAGE_ELVEES_ELCORE50
	help
	  Matching ElcoreNN / ElcoreCL / Boost from ELVEES SDK 2025.09.
	  Private library directory; no libcpunn CPU inference backend.
```

## package/elvees-felix/Config.in
```kconfig
config BR2_PACKAGE_ELVEES_FELIX
	bool "ELVEES Felix ISP binaries"
	depends on BR2_LINUX_KERNEL && BR2_INSTALL_LIBSTDCPP && !BR2_STATIC_LIBS
	select BR2_PACKAGE_LIBDRM
	select BR2_PACKAGE_LIBGPIOD
	select BR2_PACKAGE_ELVEES_SENSOR_PHY
	select BR2_PACKAGE_ELVEES_DMABUF_EXPORTER
	help
	  Vendor Felix ISP module/tools. Pinned to Linux 6.18.18.
	  sensor-phy and dmabuf-exporter are built from source.
```

## package/elvees-gst-felix/Config.in
```kconfig
config BR2_PACKAGE_ELVEES_GST_FELIX
	bool "ELVEES GStreamer Felix source"
	depends on BR2_LINUX_KERNEL && BR2_TOOLCHAIN_USES_GLIBC
	depends on BR2_INSTALL_LIBSTDCPP && !BR2_STATIC_LIBS
	select BR2_PACKAGE_GSTREAMER1
	select BR2_PACKAGE_ELVEES_FELIX
```

## package/elvees-gst-omx/Config.in
```kconfig
config BR2_PACKAGE_ELVEES_GST_OMX
	bool "ELVEES GStreamer OpenMAX VPU plugin"
	depends on BR2_LINUX_KERNEL && BR2_TOOLCHAIN_USES_GLIBC && !BR2_STATIC_LIBS
	depends on BR2_TOOLCHAIN_HAS_THREADS && BR2_USE_WCHAR && BR2_USE_MMU
	select BR2_PACKAGE_ELVEES_VPU_LIBS
	select BR2_PACKAGE_GST1_PLUGINS_BASE
	help
	  Source-built ELVEES gst-omx fork, including omxh264enc/omxmjpegenc
	  and the corresponding hardware decoder elements.
```

## package/elvees-mcom03-tools/Config.in
```kconfig
config BR2_PACKAGE_HOST_ELVEES_MCOM03_TOOLS
	bool
	help
	  ELVEES MCom-03 host tools: bootrom-tools (mksbimage,
	  otpcreator) and the MIPS32 bare-metal toolchain used by
	  ddrinit and the SBL.
```

## package/elvees-powervr-graphics/Config.in
```kconfig
config BR2_PACKAGE_ELVEES_POWERVR_GRAPHICS
	bool "PowerVR GE8300 EGL/GLES/GBM"
	depends on BR2_aarch64 && BR2_LINUX_KERNEL && BR2_TOOLCHAIN_USES_GLIBC
	depends on BR2_INSTALL_LIBSTDCPP && !BR2_STATIC_LIBS
	depends on BR2_TOOLCHAIN_HAS_THREADS_NPTL
	select BR2_PACKAGE_ELVEES_POWERVR_OPENCL
	select BR2_PACKAGE_EXPAT
	select BR2_PACKAGE_WAYLAND
	select BR2_PACKAGE_MESA3D_HEADERS
	select BR2_PACKAGE_HAS_LIBEGL
	select BR2_PACKAGE_HAS_LIBGLES
	select BR2_PACKAGE_HAS_LIBGBM
	select BR2_PACKAGE_LIBGBM_HAS_FEATURE_DMA_BUF
	select BR2_PACKAGE_LIBGBM_HAS_FEATURE_FORMAT_MODIFIER_PLANE_COUNT
	help
	  Vendor GLES and source-built ELVEES Mesa 17 EGL/GBM, including
	  the device-query and DMA-BUF compatibility fixes tested on Astra.

if BR2_PACKAGE_ELVEES_POWERVR_GRAPHICS
config BR2_PACKAGE_PROVIDES_LIBEGL
	default "elvees-powervr-graphics"
config BR2_PACKAGE_PROVIDES_LIBGLES
	default "elvees-powervr-graphics"
config BR2_PACKAGE_PROVIDES_LIBGBM
	default "elvees-powervr-graphics"
endif
```

## package/elvees-powervr-opencl/Config.in
```kconfig
config BR2_PACKAGE_ELVEES_POWERVR_OPENCL
	bool "PowerVR GE8300 OpenCL 1.2 runtime"
	depends on BR2_LINUX_KERNEL && BR2_TOOLCHAIN_USES_GLIBC
	depends on BR2_INSTALL_LIBSTDCPP && !BR2_STATIC_LIBS
	select BR2_PACKAGE_ELVEES_ROGUE_MODULES
	select BR2_PACKAGE_LIBDRM
	select BR2_PACKAGE_OPENCL_HEADERS
	select BR2_PACKAGE_HAS_LIBOPENCL
	help
	  Pinned ELVEES SDK PowerVR OpenCL runtime, online compiler and
	  GPU firmware. Source-built kernel module is loaded at boot.
	  Provides GPU OpenCL 1.2 Embedded Profile, without taking HDMI.

if BR2_PACKAGE_ELVEES_POWERVR_OPENCL
config BR2_PACKAGE_PROVIDES_LIBOPENCL
	default "elvees-powervr-opencl"
endif
```

## package/elvees-rogue-modules/Config.in
```kconfig
config BR2_PACKAGE_ELVEES_ROGUE_MODULES
	bool "PowerVR GE8300 vendor GPU kernel module"
	depends on BR2_LINUX_KERNEL
	help
	  Source-built ELVEES Rogue DDK 1.9 kernel module, adapted to Linux
	  6.18. Requires matching vendor firmware and graphics libraries
	  to run OpenGL ES / Vulkan applications. See sdk2/GPU.md.
```

## package/elvees-sensor-phy/Config.in
```kconfig
config BR2_PACKAGE_ELVEES_SENSOR_PHY
	bool "elvees-sensor-phy"
	depends on BR2_LINUX_KERNEL
	help
	  ELVEES external kernel module, built against the selected kernel.
	  Sources imported from the official ALT Linux source RPM; see ORIGIN.
```

## package/elvees-vpu-libs/Config.in
```kconfig
config BR2_PACKAGE_ELVEES_VPU_LIBS
	bool "ELVEES Mali-V61 OpenMAX runtime"
	depends on BR2_TOOLCHAIN_USES_GLIBC && !BR2_STATIC_LIBS
	depends on BR2_LINUX_KERNEL
	select BR2_PACKAGE_ELVEES_VPU_MODULES
	help
	  Pinned vendor OpenMAX encoder/decoder library and headers.
```

## package/elvees-vpu-modules/Config.in
```kconfig
config BR2_PACKAGE_ELVEES_VPU_MODULES
	bool "ELVEES Mali-V61 VPU kernel modules and firmware"
	depends on BR2_LINUX_KERNEL
	help
	  Source-built mve_rsrc/mve_base for MCom-03 and codec firmware,
	  from the public complete ELVEES SDK source distribution.
```

## package/elvees-yolov8n/Config.in
```kconfig
config BR2_PACKAGE_ELVEES_YOLOV8N
	bool "YOLOv8n COCO model converted by ELVEES"
	help
	  640x640 FP16 ElcoreNN model and bicycle smoke-test image.
```

## package/inmys-browser/Config.in
```kconfig
config BR2_PACKAGE_INMYS_BROWSER
	bool "manual Weston + Cog session"
	depends on BR2_LINUX_KERNEL && BR2_PACKAGE_HAS_UDEV
	depends on BR2_ENABLE_LOCALE && BR2_USE_WCHAR && BR2_USE_MMU
	depends on BR2_INSTALL_LIBSTDCPP && BR2_TOOLCHAIN_USES_GLIBC
	depends on BR2_TOOLCHAIN_HAS_THREADS_NPTL && !BR2_STATIC_LIBS
	depends on BR2_TOOLCHAIN_HEADERS_AT_LEAST_3_12
	depends on BR2_PACKAGE_LIBSECCOMP_ARCH_SUPPORTS
	depends on BR2_TOOLCHAIN_GCC_AT_LEAST_11 && BR2_HOST_GCC_AT_LEAST_7
	depends on BR2_TOOLCHAIN_HAS_SYNC_4
	select BR2_PACKAGE_ELVEES_POWERVR_GRAPHICS
	select BR2_PACKAGE_ELVEES_VPU_MODULES
	select BR2_PACKAGE_WESTON
	select BR2_PACKAGE_WESTON_DRM
	select BR2_PACKAGE_WPEWEBKIT
	select BR2_PACKAGE_WPEWEBKIT_SANDBOX
	select BR2_PACKAGE_WPEWEBKIT_MULTIMEDIA
	select BR2_PACKAGE_WPEWEBKIT_MEDIA_STREAM
	select BR2_PACKAGE_COG
	select BR2_PACKAGE_COG_PLATFORM_FDO
	select BR2_PACKAGE_GST1_PLUGINS_GOOD_PLUGIN_INTERLEAVE
	select BR2_PACKAGE_GST1_PLUGINS_GOOD_PLUGIN_AUDIOPARSERS
	select BR2_PACKAGE_GST1_PLUGINS_GOOD_PLUGIN_V4L2
	select BR2_PACKAGE_GST1_PLUGINS_GOOD_PLUGIN_V4L2_PROBE
	select BR2_PACKAGE_GST1_PLUGINS_BAD_PLUGIN_VIDEOPARSERS
	select BR2_PACKAGE_GST1_PLUGINS_BAD_PLUGIN_WEBRTC
	select BR2_PACKAGE_GST1_PLUGINS_BASE_PLUGIN_VIDEOTESTSRC
	select BR2_PACKAGE_GST1_PLUGINS_BASE_PLUGIN_AUDIOTESTSRC
	select BR2_PACKAGE_GST1_PLUGINS_BASE_PLUGIN_AUDIOMIXER
	select BR2_PACKAGE_GST1_PLUGINS_BAD_PLUGIN_INTER
	select BR2_PACKAGE_GST1_PLUGINS_BASE_PLUGIN_OPUS
	select BR2_PACKAGE_GST1_PLUGINS_BASE_LIB_OPENGL
	select BR2_PACKAGE_GST1_PLUGINS_BASE_LIB_OPENGL_GLES2
	select BR2_PACKAGE_GST1_PLUGINS_BASE_LIB_OPENGL_EGL
	select BR2_PACKAGE_GST1_PLUGINS_BASE_LIB_OPENGL_WAYLAND
	select BR2_PACKAGE_WPEWEBKIT_USE_GSTREAMER_GL
	select BR2_PACKAGE_CA_CERTIFICATES
	select BR2_PACKAGE_GLIB_NETWORKING
	select BR2_PACKAGE_SHARED_MIME_INFO
	select BR2_PACKAGE_DEJAVU
	help
	  inmys-browser URL stops inmys-vision and runs Weston and Cog.
	  On exit, it releases the display and restarts inmys-vision.
	  Nothing is started automatically at boot.

config BR2_PACKAGE_INMYS_BROWSER_CAMERA
	bool "CSI camera bridge for browser calls"
	depends on BR2_PACKAGE_INMYS_BROWSER
	select BR2_PACKAGE_LIBGPIOD
	select BR2_PACKAGE_ELVEES_GST_FELIX
	select BR2_PACKAGE_GST1_PLUGINS_BASE_PLUGIN_VIDEORATE
	help
	  inmys-browser --camera URL exposes Felix CSI/ISP via DMA-BUF over a Unix socket
	  and allows camera/microphone access for that browser session.
	  Stops the camera bridge before restoring inmys-vision on exit.
```
