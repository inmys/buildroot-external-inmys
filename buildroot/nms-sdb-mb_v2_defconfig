## buildroot/nms-sdb-mb_v2_defconfig
```kconfig
BR2_arm=y
BR2_cortex_a7=y
BR2_TOOLCHAIN_EXTERNAL=y
BR2_TOOLCHAIN_EXTERNAL_CUSTOM=y
BR2_TOOLCHAIN_EXTERNAL_PATH="../../../../tools/linux/toolchain/arm-rockchip830-linux-uclibcgnueabihf"
BR2_TOOLCHAIN_EXTERNAL_CUSTOM_PREFIX="arm-rockchip830-linux-uclibcgnueabihf"
BR2_TOOLCHAIN_EXTERNAL_GCC_8=y
BR2_TOOLCHAIN_EXTERNAL_HEADERS_5_10=y
BR2_TOOLCHAIN_EXTERNAL_WCHAR=y
BR2_TOOLCHAIN_EXTERNAL_HAS_SSP=y
BR2_TOOLCHAIN_EXTERNAL_CXX=y
BR2_PRIMARY_SITE="http://sources.buildroot.net"
BR2_PRIMARY_SITE_ONLY=y
BR2_OPTIMIZE_3=y
BR2_TARGET_GENERIC_HOSTNAME="luckfox pico"
BR2_TARGET_GENERIC_ISSUE="Welcome to luckfox pico"
BR2_TARGET_GENERIC_ROOT_PASSWD="luckfox"
BR2_PACKAGE_BUSYBOX_SHOW_OTHERS=y
BR2_PACKAGE_E2FSPROGS_RESIZE2FS=y
BR2_PACKAGE_PYTHON3=y
BR2_PACKAGE_PYTHON3_SSL=y
BR2_PACKAGE_PYTHON_AIOHTTP=y
BR2_PACKAGE_PYTHON_CLICK=y
BR2_PACKAGE_PYTHON_ITSDANGEROUS=y
BR2_PACKAGE_PYTHON_JINJA2=y
BR2_PACKAGE_PYTHON_PERIPHERY=y
BR2_PACKAGE_PYTHON_PILLOW=y
BR2_PACKAGE_PYTHON_SERIAL=y
BR2_PACKAGE_PYTHON_SETUPTOOLS=y
BR2_PACKAGE_PYTHON_SMBUS_CFFI=y
BR2_PACKAGE_PYTHON_SPIDEV=y
BR2_PACKAGE_PYTHON_WERKZEUG=y
BR2_PACKAGE_OPENSSH=y
BR2_PACKAGE_SAMBA4=y
BR2_PACKAGE_TIME=y
BR2_PACKAGE_HTOP=y
BR2_PACKAGE_NANO=y
BR2_PACKAGE_MMC_UTILS=y                                                                                                                                                                                   
# BR2_PACKAGE_MMC_UTILS_ENABLE_DANGEROUS_COMMANDS is not set                                                                                                                                              
BR2_PACKAGE_MTD=y
#
# MTD tools selection
#
# BR2_PACKAGE_MTD_DOCFDISK is not set
# BR2_PACKAGE_MTD_DOC_LOADBIOS is not set
BR2_PACKAGE_MTD_FLASHCP=y
BR2_PACKAGE_MTD_FLASH_ERASE=y
BR2_PACKAGE_MTD_FLASH_LOCK=y
# BR2_PACKAGE_MTD_FLASH_OTP_DUMP is not set
# BR2_PACKAGE_MTD_FLASH_OTP_INFO is not set
# BR2_PACKAGE_MTD_FLASH_OTP_LOCK is not set
# BR2_PACKAGE_MTD_FLASH_OTP_WRITE is not set
# BR2_PACKAGE_MTD_FLASH_OTP_ERASE is not set
BR2_PACKAGE_MTD_FLASH_UNLOCK=y
# BR2_PACKAGE_MTD_FTL_CHECK is not set
# BR2_PACKAGE_MTD_FTL_FORMAT is not set
# BR2_PACKAGE_MTD_JFFS2DUMP is not set
# BR2_PACKAGE_MTD_LSMTD is not set
# BR2_PACKAGE_MTD_MKFSJFFS2 is not set
# BR2_PACKAGE_MTD_MKFSUBIFS is not set
BR2_PACKAGE_MTD_MTD_DEBUG=y
# BR2_PACKAGE_MTD_MTDPART is not set
BR2_PACKAGE_MTD_NANDDUMP=y
BR2_PACKAGE_MTD_NANDTEST=y
BR2_PACKAGE_MTD_NANDWRITE=y
# BR2_PACKAGE_MTD_NANDFLIPBITS is not set
# BR2_PACKAGE_MTD_NFTLDUMP is not set
# BR2_PACKAGE_MTD_NFTL_FORMAT is not set
# BR2_PACKAGE_MTD_RECV_IMAGE is not set
# BR2_PACKAGE_MTD_RFDDUMP is not set
# BR2_PACKAGE_MTD_RFDFORMAT is not set
# BR2_PACKAGE_MTD_SERVE_IMAGE is not set
# BR2_PACKAGE_MTD_SUMTOOL is not set
BR2_PACKAGE_MTD_MTDINFO=y
BR2_PACKAGE_MTD_UBIATTACH=y
BR2_PACKAGE_MTD_UBICRC32=y
BR2_PACKAGE_MTD_UBIDETACH=y
BR2_PACKAGE_MTD_UBIFORMAT=y
BR2_PACKAGE_MTD_UBIHEALTHD=y
BR2_PACKAGE_MTD_UBIMKVOL=y
BR2_PACKAGE_MTD_UBINFO=y
BR2_PACKAGE_MTD_UBINIZE=y
BR2_PACKAGE_MTD_UBIRENAME=y
BR2_PACKAGE_MTD_UBIRMVOL=y
BR2_PACKAGE_MTD_UBIRSVOL=y
BR2_PACKAGE_MTD_UBIUPDATEVOL=y
BR2_PACKAGE_MTD_UBIBLOCK=y
# BR2_PACKAGE_MTD_TESTS is not set
```

## kernel/drivers/gpio/Kconfig
```kconfig
if GPIOLIB


config GPIO_AW9523
        tristate "AW9523 Driver"
        help
          16-bit i2c gpio extender

endif
```

## kernel/drivers/rtc/Kconfig
```kconfig
if RTC_CLASS

config RTC_BL5372
        tristate "RTC BL5372"
        default m
        help
         Driver for BL5372 RTC module

endif
```

## package/libwt/Config.in
```kconfig
config BR2_PACKAGE_LIBWT
	bool "libwt"
	depends on BR2_PACKAGE_BOOST
	help
	  Wt (pronounced as witty) is a C++ library for developing web applications.
	  http://webtoolkit.eu/
```

## package/localgui/Config.in
```kconfig
config BR2_PACKAGE_LOCALGUI
	bool "localgui"
	depends on BR2_PACKAGE_LIBWT
	help
	  Local web gui
```

## package/qt6/Config.in.host
```kconfig
if BR2_PACKAGE_QT6

source "$BR2_EXTERNAL_INMYS_PATH/package/qt6/qt6base/Config.in.host"

endif
```

## package/qt6/qt6declarative/Config.in
```kconfig
config BR2_PACKAGE_QT6DECLARATIVE
	bool "qt6declarative"
	help
	  https://doc.qt.io/qt-6/qtquick-index.html
```

## package/qt6/qt6multimedia/Config.in
```kconfig
config BR2_PACKAGE_QT6MULTIMEDIA
	bool "qt6multimedia"
	select BR2_PACKAGE_QT6SHADERTOOLS
	help
```

## package/qt6/qt6networkauth/Config.in
```kconfig
config BR2_PACKAGE_QT6NETWORKAUTH
	bool "qt6networkauth"
	select BR2_PACKAGE_HOST_QT6BASE_NETWORK
	help
```

## package/rockchip_canfd/Config.in
```kconfig
config BR2_PACKAGE_ROCKCHIP_CANFD_KERNEL_MODULE
	bool "rockchip_canfd"
	depends on BR2_LINUX_KERNEL
	help
	  Kernel module for rk3568 CANFD controller.
	  Ported from kernel 4.19 to 6.1.

comment "rockchip_canfd needs a Linux kernel to be built"
	depends on !BR2_LINUX_KERNEL
```
